## boards/custom_l475/board.yml
```yaml
board:
  name: custom_l475
  full_name: Custom L475 board (copy of B-L475E-IOT01A)
  vendor: st
  socs:
    - name: stm32l475xx
```

## boards/scratch_l475/board.yml
```yaml
board:
  name: scratch_l475
  full_name: Scratch-built STM32L475 board
  vendor: st
  socs:
    - name: stm32l475xx
```

## boards/scratch_l475/scratch_l475_defconfig
```kconfig
# Serial console
CONFIG_SERIAL=y
CONFIG_CONSOLE=y
CONFIG_UART_CONSOLE=y

# GPIO for the LED
CONFIG_GPIO=y

# Memory protection
CONFIG_ARM_MPU=y
CONFIG_HW_STACK_PROTECTION=y
```

## drivers/led_sensor/Kconfig
```kconfig
menuconfig LED_SENSOR
	bool "LED sensor driver"
	default y
	depends on DT_HAS_IOMICO_LED_SENSOR_ENABLED
	select GPIO
	help
	  Driver that exposes an on-board LED through the Sensor API.
	  sensor_sample_fetch() turns the LED on, sensor_channel_get()
	  turns it off.
```

## dts/bindings/sensor/iomico,led-sensor.yaml
```yaml
description: LED exposed through the Zephyr Sensor API (course exercise)

compatible: "iomico,led-sensor"

include: sensor-device.yaml

properties:
  led-gpios:
    type: phandle-array
    required: true
    description: GPIO the LED is connected to.
```
