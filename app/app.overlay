/ {
    aliases {
        /* app-led: the LED this application blinks.
         * On disco_l475_iot1, led0 is &green_led_2 */
        app-led = &green_led_2;
    };

    /* LED LD2 (PB14) exposed through our custom Sensor API driver. */
    led_sensor: led_sensor {
        compatible = "iomico,led-sensor";
        led-gpios = <&gpiob 14 GPIO_ACTIVE_HIGH>;
        status = "okay";
    };
};
